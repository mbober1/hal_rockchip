## dts/bindings/serial/rockchip,uart.yaml
```yaml
# Copyright (c) 2026 Marcin Bober
# SPDX-License-Identifier: Apache-2.0

title: Rockchip UART

description: |
  Rockchip UART

compatible: "rockchip,uart"

include: [uart-controller.yaml, pinctrl-device.yaml]

properties:
  reg:
    required: true

  current-speed:
    required: true

  pinctrl-0:
    required: true

  pinctrl-names:
    required: true
```

## dts/bindings/watchdog/rockchip,rk3506-wdt.yaml
```yaml
# Copyright (c) 2026 Marcin Bober
# SPDX-License-Identifier: Apache-2.0

title: Rockchip RK3506 Watchdog

maintainers:
  - Marcin Bober <mbober1@gmail.com>

description: |
  Clocked from XIN_OSC0 (24 MHz). Only one instance may be enabled. A timeout with
  WDT_FLAG_RESET_SOC triggers a global SoC reset, which also resets the A7.

compatible: "rockchip,rk3506-wdt"

include: base.yaml

properties:
  reg:
    required: true

  interrupts:
    required: true
```

## soc/rockchip/Kconfig
```kconfig
# Copyright (c) 2026 Marcin Bober
# SPDX-License-Identifier: Apache-2.0
#

if SOC_FAMILY_ROCKCHIP

rsource "*/Kconfig"

endif # SOC_FAMILY_ROCKCHIP
```

## soc/rockchip/Kconfig.soc
```kconfig
# Copyright (c) 2026 Marcin Bober
# SPDX-License-Identifier: Apache-2.0
#

config SOC_FAMILY_ROCKCHIP
	bool

config SOC_FAMILY
	default "rockchip" if SOC_FAMILY_ROCKCHIP

rsource "*/Kconfig.soc"
```

## soc/rockchip/rk35/Kconfig.defconfig
```kconfig
# Copyright (c) 2026 Marcin Bober
# SPDX-License-Identifier: Apache-2.0

rsource "*/Kconfig.defconfig"
```

## soc/rockchip/rk35/rk3506/Kconfig.defconfig
```kconfig
# SPDX-License-Identifier: Apache-2.0

if SOC_SERIES_RK35

if DT_HAS_ROCKCHIP_INTMUX_ENABLED

config MULTI_LEVEL_INTERRUPTS
	default y

config 2ND_LEVEL_INTERRUPTS
	default y

config MAX_IRQ_PER_AGGREGATOR
	default 32

config NUM_2ND_LEVEL_AGGREGATORS
	default 4

config 2ND_LVL_ISR_TBL_OFFSET
	default 32

config 2ND_LVL_INTR_00_OFFSET
	default 28

config 2ND_LVL_INTR_01_OFFSET
	default 29

config 2ND_LVL_INTR_02_OFFSET
	default 30

config 2ND_LVL_INTR_03_OFFSET
	default 31

endif # DT_HAS_ROCKCHIP_INTMUX_ENABLED

config NUM_IRQS
	default 160 if DT_HAS_ROCKCHIP_INTMUX_ENABLED
	default 32

config SYS_CLOCK_HW_CYCLES_PER_SEC
	default $(dt_node_int_prop_int,/cpus/cpu@0,clock-frequency)

endif # SOC_SERIES_RK35
```

## soc/rockchip/rk35/rk3506/Kconfig.soc
```kconfig
# Copyright (c) 2026 Marcin Bober
# SPDX-License-Identifier: Apache-2.0

config SOC_RK3506
	bool
	select SOC_SERIES_RK35
	select ARM
	select CPU_CORTEX_M0
	select CPU_CORTEX_M_HAS_SYSTICK
	select SOC_EARLY_INIT_HOOK
	help
	  Enable support for the Rockchip RK3506 MCU

config SOC
	default "rk3506" if SOC_RK3506
```
