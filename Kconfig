## Kconfig
```kconfig
# Copyright (c) 2026 Marcin Bober
# SPDX-License-Identifier: Apache-2.0

rsource "drivers/adc/Kconfig"
rsource "drivers/counter/Kconfig"
rsource "drivers/gpio/Kconfig"
rsource "drivers/interrupt_controller/Kconfig"
rsource "drivers/mbox/Kconfig"
rsource "drivers/misc/Kconfig"
rsource "drivers/pinctrl/Kconfig"
rsource "drivers/pwm/Kconfig"
rsource "drivers/serial/Kconfig"
rsource "drivers/watchdog/Kconfig"
```

## boards/luckfox/luckfox_lyra_plus/Kconfig.luckfox_lyra_plus
```kconfig
# Copyright (c) 2026 Marcin Bober
# SPDX-License-Identifier: Apache-2.0

config BOARD_LUCKFOX_LYRA_PLUS
	select SOC_RK3506 if BOARD_LUCKFOX_LYRA_PLUS_RK3506
```

## boards/luckfox/luckfox_lyra_plus/board.yml
```yaml
board:
  name: luckfox_lyra_plus
  full_name: Luckfox Lyra Plus (RK3506 Cortex-M0)
  vendor: luckfox
  socs:
    - name: rk3506
```

## boards/luckfox/luckfox_lyra_plus/luckfox_lyra_plus_rk3506_defconfig
```kconfig
# Copyright (c) 2026 Marcin Bober
# SPDX-License-Identifier: Apache-2.0

CONFIG_XIP=n
CONFIG_GPIO=y

CONFIG_SERIAL=y
CONFIG_CONSOLE=y
CONFIG_UART_CONSOLE=y
CONFIG_PRINTK=y
```

## drivers/gpio/Kconfig
```kconfig
# Copyright (c) 2026 Marcin Bober
# SPDX-License-Identifier: Apache-2.0

config GPIO_ROCKCHIP
	bool "Rockchip GPIO driver"
	default y
	depends on DT_HAS_ROCKCHIP_GPIO_ENABLED
```

## drivers/interrupt_controller/Kconfig
```kconfig
# Copyright (c) 2026 Marcin Bober
# SPDX-License-Identifier: Apache-2.0

config INTC_ROCKCHIP_INTMUX
	bool "Rockchip INTMUX second-level interrupt controller"
	default y
	depends on DT_HAS_ROCKCHIP_INTMUX_ENABLED
	depends on MULTI_LEVEL_INTERRUPTS && 2ND_LEVEL_INTERRUPTS
```

## drivers/pinctrl/Kconfig
```kconfig
# Copyright (c) 2026 Marcin Bober
# SPDX-License-Identifier: Apache-2.0

config PINCTRL_ROCKCHIP
	bool "Rockchip pin controller driver"
	default y
	depends on DT_HAS_ROCKCHIP_PINCTRL_ENABLED
	depends on PINCTRL
```

## drivers/pwm/Kconfig
```kconfig
# Copyright (c) 2026 Marcin Bober
# SPDX-License-Identifier: Apache-2.0

config PWM_ROCKCHIP
	bool "Rockchip PWM driver"
	default y
	depends on DT_HAS_ROCKCHIP_PWM_ENABLED
	depends on PWM
	select PINCTRL
```

## drivers/serial/Kconfig
```kconfig
# Copyright (c) 2026 Marcin Bober
# SPDX-License-Identifier: Apache-2.0

config UART_ROCKCHIP
	bool "Rockchip UART driver"
	default y
	depends on DT_HAS_ROCKCHIP_UART_ENABLED
	select SERIAL_HAS_DRIVER
	select SERIAL_SUPPORT_INTERRUPT
	select PINCTRL
```

## drivers/watchdog/Kconfig
```kconfig
# Copyright (c) 2026 Marcin Bober
# SPDX-License-Identifier: Apache-2.0

config WDT_ROCKCHIP
	bool "Rockchip watchdog driver"
	default y
	depends on DT_HAS_ROCKCHIP_WDT_ENABLED
	depends on WATCHDOG
```

## dts/bindings/adc/rockchip,rk3506-saradc.yaml
```yaml
# Copyright (c) 2026 Marcin Bober
# SPDX-License-Identifier: Apache-2.0

title: Rockchip RK3506 Successive Approximation Register (SAR) A/D Converter

description: |
  Rockchip RK3506 Successive Approximation Register

compatible: "rockchip,rk3506-saradc"

include: adc-controller.yaml

properties:
  reg:
    required: true

  vref-mv:
    type: int
    default: 1800
    description: Reference voltage in mV (SARADC_AVDD1V8).

  "#io-channel-cells":
    const: 1

io-channel-cells:
  - input
```

## dts/bindings/adc/rockchip,saradc.yaml
```yaml
# Copyright (c) 2026 Marcin Bober
# SPDX-License-Identifier: Apache-2.0

title: Rockchip Successive Approximation Register (SAR) A/D Converter

description: |
  Rockchip Successive Approximation Register

compatible: "rockchip,saradc"

include: adc-controller.yaml

properties:
  reg:
    required: true

  vref-mv:
    type: int
    default: 1800
    description: Reference voltage in mV (SARADC_AVDD1V8).

  "#io-channel-cells":
    const: 1

io-channel-cells:
  - input
```

## dts/bindings/counter/rockchip,rk3506-timer.yaml
```yaml
# Copyright (c) 2026 Marcin Bober
# SPDX-License-Identifier: Apache-2.0

title: Rockchip RK3506 Timer

maintainers:
  - Marcin Bober <mbober1@gmail.com>

description: |
  Rockchip RK3506 64-bit timer channel (TIMER0-11), exposed through the
  Zephyr counter API and clocked from XIN_OSC0 (24 MHz). Without an
  interrupt the counter works but alarms and top-value callbacks are
  unavailable.

compatible: "rockchip,rk3506-timer"

include: base.yaml

properties:
  reg:
    required: true
```

## dts/bindings/counter/rockchip,timer.yaml
```yaml
# Copyright (c) 2026 Marcin Bober
# SPDX-License-Identifier: Apache-2.0

title: Rockchip Timer

description: |
  Rockchip 64-bit timer channel (TIMER0-11), exposed through the
  Zephyr counter API and clocked from XIN_OSC0 (24 MHz). Without an
  interrupt the counter works but alarms and top-value callbacks are
  unavailable.

compatible: "rockchip,timer"

include: base.yaml

properties:
  reg:
    required: true
```

## dts/bindings/gpio/rockchip,gpio.yaml
```yaml
# Copyright (c) 2026 Marcin Bober
# SPDX-License-Identifier: Apache-2.0

title: Rockchip GPIO

description: |
  Rockchip GPIO controller

compatible: "rockchip,gpio"

include: [gpio-controller.yaml, base.yaml]

properties:
  reg:
    required: true

  bank-id:
    type: int
    required: true
    description: HAL bank index (eGPIO_bankId), e.g. 1 for GPIO1.

gpio-cells:
  - pin
  - flags
```

## dts/bindings/gpio/rockchip,rk3506-gpio.yaml
```yaml
# Copyright (c) 2026 Marcin Bober
# SPDX-License-Identifier: Apache-2.0

title: Rockchip RK3506 GPIO

description: |
  Rockchip RK3506 GPIO

compatible: "rockchip,rk3506-gpio"

include: [gpio-controller.yaml, base.yaml]

properties:
  reg:
    required: true

  bank-id:
    type: int
    required: true
    description: HAL bank index (eGPIO_bankId), e.g. 1 for GPIO1.

gpio-cells:
  - pin
  - flags
```

## dts/bindings/interrupt-controller/rockchip,intmux-ch.yaml
```yaml
# Copyright (c) 2026 Marcin Bober
# SPDX-License-Identifier: Apache-2.0

title: Rockchip INTMUX Channel

description: |
  One Rockchip INTMUX group of 32 inputs. The interrupt specifier is the
  line within the group (INTMUX source ID modulo 32).

compatible: "rockchip,intmux-ch"

include: [interrupt-controller.yaml, base.yaml]

properties:
  reg:
    required: true

  interrupts:
    required: true

interrupt-cells:
  - irq
```

## dts/bindings/interrupt-controller/rockchip,intmux.yaml
```yaml
# Copyright (c) 2026 Marcin Bober
# SPDX-License-Identifier: Apache-2.0

title: Rockchip INTMUX

description: |
  Routes 128 peripheral IRQs to the M0 NVIC as
  four groups of 32; group n drives NVIC line 28 + n. Each group is a child
  node with compatible "rockchip,intmux-ch".

compatible: "rockchip,intmux"

include: base.yaml

properties:
  reg:
    required: true
```

## dts/bindings/interrupt-controller/rockchip,rk3506-intmux-ch.yaml
```yaml
# Copyright (c) 2026 Marcin Bober
# SPDX-License-Identifier: Apache-2.0

title: Rockchip RK3506 INTMUX Channel

description: |
  One RK3506 INTMUX group of 32 inputs. The interrupt specifier is the
  line within the group (INTMUX source ID modulo 32).

compatible: "rockchip,rk3506-intmux-ch"

include: [interrupt-controller.yaml, base.yaml]

properties:
  reg:
    required: true

  interrupts:
    required: true

interrupt-cells:
  - irq
```

## dts/bindings/interrupt-controller/rockchip,rk3506-intmux.yaml
```yaml
# Copyright (c) 2026 Marcin Bober
# SPDX-License-Identifier: Apache-2.0

title: Rockchip RK3506 INTMUX

maintainers:
  - Marcin Bober <mbober1@gmail.com>

description: |
  Routes 128 peripheral IRQs to the M0 NVIC as
  four groups of 32; group n drives NVIC line 28 + n. Each group is a child
  node with compatible "rockchip,rk3506-intmux-ch".

compatible: "rockchip,rk3506-intmux"

include: base.yaml

properties:
  reg:
    required: true
```

## dts/bindings/mbox/rockchip,rk3506-mbox.yaml
```yaml
# Copyright (c) 2026 Marcin Bober
# SPDX-License-Identifier: Apache-2.0

title: Rockchip RK3506 Mailbox

maintainers:
  - Marcin Bober <mbober1@gmail.com>

description: |
  One group per 4 KB instance. The Cortex-M0 is
  the BB side: it receives on A2B and sends on B2A.
  Only one instance can be routed to M0 IRQ 22.

compatible: "rockchip,rk3506-mbox"

include: [base.yaml, mailbox-controller.yaml]

properties:
  reg:
    required: true

  interrupts:
    required: true

mbox-cells:
  - channel
```

## dts/bindings/pinctrl/rockchip,pinctrl.yaml
```yaml
# Copyright (c) 2026 Marcin Bober
# SPDX-License-Identifier: Apache-2.0

title: Rockchip pin controller

description: |
  Pin function selection through the per-bank IOMUX or the RMIO matrix.
  Pin values are built with RK_PINMUX() or RK_RMIO() from
  <zephyr/dt-bindings/pinctrl/rockchip-pinctrl.h>, for example:

    &pinctrl {
      uart4_default: uart4_default {
        group0 {
          pinmux = <RK_RMIO(1, RK_PC2, RK_RMIO_UART4_TX)>;
        };
        group1 {
          pinmux = <RK_RMIO(1, RK_PC3, RK_RMIO_UART4_RX)>;
          bias-pull-up;
        };
      };
    };

  Properties that are not given leave the hardware setting unchanged.

compatible: "rockchip,pinctrl"

include: base.yaml

child-binding:
  description: Pin controller state.
  child-binding:
    description: Group of pins sharing the same configuration.

    include:
      - name: pincfg-node.yaml
        property-allowlist:
          - bias-disable
          - bias-pull-up
          - bias-pull-down
          - input-schmitt-enable
          - drive-strength

    properties:
      pinmux:
        required: true
        type: array
        description: Pins built with RK_PINMUX() or RK_RMIO().
      drive-strength:
        enum: [0, 1, 2, 3, 4, 5]
        description: Drive strength level (HAL PIN_CONFIG_DRV_LEVELn).
```

## dts/bindings/pinctrl/rockchip,rk3506-pinctrl.yaml
```yaml
# Copyright (c) 2026 Marcin Bober
# SPDX-License-Identifier: Apache-2.0

title: Rockchip RK3506 pin controller

maintainers:
  - Marcin Bober <mbober1@gmail.com>

description: |
  Pin function selection through the per-bank IOMUX or the RMIO matrix.
  Pin values are built with RK3506_PINMUX() or RK3506_RMIO() from
  <zephyr/dt-bindings/pinctrl/rk3506-pinctrl.h>, for example:

    &pinctrl {
      uart4_default: uart4_default {
        group0 {
          pinmux = <RK3506_RMIO(1, RK_PC2, RK3506_RMIO_UART4_TX)>;
        };
        group1 {
          pinmux = <RK3506_RMIO(1, RK_PC3, RK3506_RMIO_UART4_RX)>;
          bias-pull-up;
        };
      };
    };

  Properties that are not given leave the hardware setting unchanged.

compatible: "rockchip,rk3506-pinctrl"

include: base.yaml

child-binding:
  description: Pin controller state.
  child-binding:
    description: Group of pins sharing the same configuration.

    include:
      - name: pincfg-node.yaml
        property-allowlist:
          - bias-disable
          - bias-pull-up
          - bias-pull-down
          - input-schmitt-enable
          - drive-strength

    properties:
      pinmux:
        required: true
        type: array
        description: Pins built with RK3506_PINMUX() or RK3506_RMIO().
      drive-strength:
        enum: [0, 1, 2, 3, 4, 5]
        description: Drive strength level (HAL PIN_CONFIG_DRV_LEVELn).
```

## dts/bindings/pwm/rockchip,rk3506-pwm.yaml
```yaml
# Copyright (c) 2026 Marcin Bober
# SPDX-License-Identifier: Apache-2.0

title: Rockchip RK3506 PWM controller

maintainers:
  - Marcin Bober <mbober1@gmail.com>

description: |
  Clocked from clk_pwm_osc (24 MHz). Each channel is a child node so that
  channels can use different interrupt parents (NVIC or INTMUX). Capture
  needs the channel interrupt; INTMUX channels need &intmux enabled.

compatible: "rockchip,rk3506-pwm"

include: [pwm-controller.yaml, base.yaml, pinctrl-device.yaml]

properties:
  reg:
    required: true

  "#address-cells":
    const: 1

  "#size-cells":
    const: 0

  "#pwm-cells":
    const: 3

pwm-cells:
  - channel
  - period
  - flags

child-binding:
  description: PWM channel
  properties:
    reg:
      type: array
      required: true
      description: Channel index

    interrupts:
      type: array
      required: true
```

## dts/bindings/serial/rockchip,rk3506-uart.yaml
```yaml
# Copyright (c) 2026 Marcin Bober
# SPDX-License-Identifier: Apache-2.0

title: Rockchip RK3506 UART

description: |
  Rockchip RK3506 UART

compatible: "rockchip,rk3506-uart"

include: [uart-controller.yaml, pinctrl-device.yaml]

properties:
  reg:
    required: true

  current-speed:
    required: true

  pinctrl-0:
    required: true

  pinctrl-names:
    required: true
```
