/*
 * Copyright (c) 2026 Marcin Bober
 *
 * SPDX-License-Identifier: Apache-2.0
 */

#include <zephyr/dt-bindings/pinctrl/rockchip-pinctrl.h>

&pinctrl {
	uart4_default: uart4_default {
		group0 {
			pinmux = <RK_RMIO(1, RK_PC2, RK_RMIO_UART4_TX)>;
		};

		group1 {
			pinmux = <RK_RMIO(1, RK_PC3, RK_RMIO_UART4_RX)>;
			bias-pull-up;
		};
	};
};
